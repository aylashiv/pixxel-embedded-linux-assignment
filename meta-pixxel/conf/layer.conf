## meta-pixxel/conf/layer.conf
```bitbake
# meta-pixxel/conf/layer.conf

BBPATH .= ":${LAYERDIR}"
BBFILES += "${LAYERDIR}/recipes-*/*/*.bb"

BBFILE_COLLECTIONS += "pixxel"
BBFILE_PATTERN_pixxel = "^${LAYERDIR}/"
BBFILE_PRIORITY_pixxel = "6"

LAYERDEPENDS_pixxel = "core"
LAYERSERIES_COMPAT_pixxel = "scarthgap styhead walnascar"
```
